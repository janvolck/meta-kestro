## conf/distro/include/raspberrypi.conf
```bitbake
OE_DEVICE_EXTRA_CONFIG += ""
MACHINE_EXTRA_INSTALL += ""
EXTRA_IMAGEDEPENDS += ""

# Set preferred java version
PREFERRED_PROVIDER_virtual/java-initial-native = "cacao-initial-native"
PREFERRED_PROVIDER_virtual/java-native = "jamvm-native"
PREFERRED_PROVIDER_virtual/javac-native = "ecj-bootstrap-native"

PREFERRED_RPROVIDER_virtual/java = "openjre-8"
```

## conf/distro/include/tinker-rk3288.conf
```bitbake
OE_DEVICE_EXTRA_CONFIG += ""
MACHINE_EXTRA_INSTALL += ""
EXTRA_IMAGEDEPENDS += ""

# Set preferred java version
PREFERRED_PROVIDER_virtual/java-initial-native = "zulu-jdk-native"
PREFERRED_PROVIDER_virtual/java-native = "zulu-jdk-native"
PREFERRED_PROVIDER_virtual/javac-native = "zulu-jdk-native"

PREFERRED_RPROVIDER_virtual/java = "zulu-jre"


PREFERRED_PROVIDER_virtual/kernel = "linux-stable"
PREFERRED_PROVIDER_virtual/bootloader = "u-boot"
```

## conf/distro/poky-kestro.conf
```bitbake
include conf/distro/poky.conf

DISTRO = "poky-kestro"
DISTRO_NAME = "Kestro embedded linux solutions."

SDK_MACHINE = "${@d.getVar('SDKMACHINE', True) or '${SDK_ARCH}'}"
SDK_NAME = "${DISTRO}-${SDK_MACHINE}-${IMAGE_BASENAME}"
SDKPATH = "/opt/${DISTRO}/${SDK_VERSION}/${MACHINE}"

TOOLCHAIN_OUTPUTNAME = "${SDK_NAME}-${MACHINE}"
BUILDCFG_VARS += "SDKMACHINE"

MAINTAINER = "Jan Volckaert <janvolck@gmail.com>"

DISTRO_FEATURES_DEFAULT ?= ""
BAD_RECOMMENDATIONS += ""

LICENSE_CREATE_PACKAGE = "1"
COPY_LIC_MANIFEST = "1"

include conf/distro/include/${MACHINE}.conf
```

## conf/layer.conf
```bitbake
# We have a conf and classes directory, append to BBPATH
BBPATH .= ":${LAYERDIR}"

# We have a recipes directory, add to BBFILES
BBFILES += "${LAYERDIR}/recipes*/*/*.bb ${LAYERDIR}/recipes*/*/*.bbappend"

BBFILE_COLLECTIONS += "kestro"
BBFILE_PATTERN_kestro := "^${LAYERDIR}/"
BBFILE_PRIORITY_kestro = "20"
LAYERSERIES_COMPAT_kestro += "sumo rocko"

LICENSE_FLAGS_WHITELIST += "commercial"

# Additional license directories.
LICENSE_PATH += "${LAYERDIR}/custom-licenses"
```
